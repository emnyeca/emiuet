## firmware/main/Kconfig.projbuild
```kconfig
menu "Emiuet"

config EMIUET_MIDI_TRS_UART_ENABLE
    bool "Enable TRS MIDI OUT (UART1, 31250 baud)"
    default y
    help
        Enable the Type-A TRS MIDI OUT backend on the dedicated UART1 pin pair.

config EMIUET_MIDI_TRS_IN_ENABLE
    bool "Enable isolated TRS MIDI IN (UART1, 31250 baud)"
    default y
    depends on EMIUET_MIDI_TRS_UART_ENABLE
    help
        Read the optocoupler output on PIN_MIDI_IN_RX. The RX parser feeds the
        same MIDI input layer as USB MIDI RX.

config EMIUET_MIDI_TASK_TRS_PRIORITY
    int "TRS MIDI sender task priority"
    range 1 24
    default 7
    depends on EMIUET_MIDI_TRS_UART_ENABLE
    help
        Priority for the TRS MIDI sender task.

        This should be higher than the USB/BLE sender tasks (TRS > USB = BLE),
        but does not need to exceed input scanning tasks.

config EMIUET_MIDI_TASK_USB_PRIORITY
    int "USB MIDI sender task priority"
    range 1 24
    default 6
    help
        Priority for the USB MIDI sender task.

config EMIUET_RGB_ENABLE
    bool "Enable 78-key SK6812 RGB chain"
    default y
    help
        Drive one 78-pixel chain through Espressif led_strip and the RMT DMA
        backend. This option never enables bit-bang output.

config EMIUET_RGB_DEFAULT_BUDGET_MA
    int "RGB current budget for Type-C Default current"
    range 0 400
    default 200
    depends on EMIUET_RGB_ENABLE
    help
        Conservative LED-only budget. Validation must confirm this value because
        CC Default does not distinguish USB 2.0 500 mA from USB 3.x 900 mA.

config EMIUET_RGB_1P5A_BUDGET_MA
    int "RGB current budget for 1.5 A or 3 A advertisement"
    range 0 1200
    default 1000
    depends on EMIUET_RGB_ENABLE
    help
        LED-only budget used for both 1.5 A and 3 A advertisements. Rev.B caps
        the whole product at 1.5 A and reserves the remainder for logic.

config EMIUET_RGB_GLOBAL_BRIGHTNESS_MAX
    int "Maximum user global RGB brightness (0..255)"
    range 1 255
    default 96
    depends on EMIUET_RGB_ENABLE

config EMIUET_MIDI_TASK_BLE_PRIORITY
    int "BLE MIDI sender task priority"
    range 1 24
    default 6
    help
        Priority for the BLE MIDI sender task.

config EMIUET_MIDI_TRS_QUEUE_LEN
    int "TRS MIDI discrete event queue length"
    range 8 512
    default 64
    depends on EMIUET_MIDI_TRS_UART_ENABLE
    help
        Queue length for discrete MIDI events (Note On/Off, etc.) for TRS.

config EMIUET_MIDI_USB_QUEUE_LEN
    int "USB MIDI discrete event queue length"
    range 16 2048
    default 1024
    help
        Queue length for discrete MIDI events (Note On/Off, etc.) for USB.

config EMIUET_MIDI_BLE_QUEUE_LEN
    int "BLE MIDI discrete event queue length"
    range 16 2048
    default 256
    help
        Queue length for discrete MIDI events (Note On/Off, etc.) for BLE.

config MATRIX_SIM_ENABLED_DEFAULT
    bool "Enable matrix simulator by default"
    default n
    help
        Enable the debug key-matrix simulator at boot.

        Use this only for development when running on a dev kit without the
        real key matrix connected.

        For prototype/production bring-up this should remain disabled to avoid
        masking real hardware input issues.

endmenu
```
